## config/boards/shields/my_board/Kconfig.defconfig
```kconfig
if SHIELD_MY_BOARD_LEFT || SHIELD_MY_BOARD_RIGHT

config ZMK_KEYBOARD_NAME
    default "MyBoard"

endif
```

## config/boards/shields/my_board/Kconfig.shield
```kconfig
config SHIELD_MY_BOARD_LEFT
    bool "MyBoard (Left half)"

config SHIELD_MY_BOARD_RIGHT
    bool "MyBoard (Right half)"
```

## config/west.yml
```yaml
manifest:
  remotes:
    - name: zmkfirmware
      url-base: https://github.com/zmkfirmware
    - name: badjeff
      url-base: https://github.com/badjeff

  projects:
    - name: zmk
      remote: zmkfirmware
      revision: main
      import: app/west.yml

    # PMW3610 드라이버 모듈(대표적으로 많이 씀)
    - name: zmk-pmw3610-driver
      remote: badjeff
      revision: main

  self:
    path: config
```
