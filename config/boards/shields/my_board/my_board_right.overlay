/* Right half overlay (trackball on right) */
#include "chary.dtsi"
#include <dt-bindings/pinctrl/nrf-pinctrl.h>
#include <zephyr/dt-bindings/input/input-event-codes.h>


/* 오른쪽은 매트릭스 변환에서 컬럼 6개 오프셋 */
&default_transform {
    col-offset = <6>;
};

/* 오른쪽 컬럼 GPIO (COL0~COL5) */
&kscan0 {
    diode-direction = "col2row";
    col-gpios =
        <&pro_micro 4 (GPIO_ACTIVE_HIGH)>  /* COL0 */
        , <&pro_micro 5 (GPIO_ACTIVE_HIGH)> /* COL1 */
        , <&pro_micro 6 (GPIO_ACTIVE_HIGH)> /* COL2 */
        , <&pro_micro 7 (GPIO_ACTIVE_HIGH)> /* COL3 */
        , <&pro_micro 8 (GPIO_ACTIVE_HIGH)> /* COL4 */
        , <&pro_micro 9 (GPIO_ACTIVE_HIGH)> /* COL5 */
        ;
};

/* ===== PMW3610 Trackball (SPI0) ===== */
&pinctrl {
    spi0_default: spi0_default {
        group1 {
            psels = <NRF_PSEL(SPIM_SCK, 0, 8)>,
                    <NRF_PSEL(SPIM_MOSI, 0, 17)>,
                    <NRF_PSEL(SPIM_MISO, 0, 17)>;
        };
    };

    spi0_sleep: spi0_sleep {
        group1 {
            psels = <NRF_PSEL(SPIM_SCK, 0, 8)>,
                    <NRF_PSEL(SPIM_MOSI, 0, 17)>,
                    <NRF_PSEL(SPIM_MISO, 0, 17)>;
            low-power-enable;
        };
    };
};

&spi0 {
    status = "okay";
    compatible = "nordic,nrf-spim";
    pinctrl-0 = <&spi0_default>;
    pinctrl-1 = <&spi0_sleep>;
    pinctrl-names = "default", "sleep";

    cs-gpios = <&gpio0 20 GPIO_ACTIVE_LOW>;

trackball: trackball@0 {
    status = "okay";
    compatible = "pixart,pmw3610";
    reg = <0>;
    spi-max-frequency = <2000000>;

    /* required by pixart,pmw3610 binding */
    motion-gpios = <&gpio0 6 (GPIO_ACTIVE_LOW | GPIO_PULL_UP)>;
    zephyr,axis-x = <INPUT_REL_X>;
    zephyr,axis-y = <INPUT_REL_Y>;
};


/* 트랙볼 입력 리스너 등록 */
 / {
    trackball_listener {
        compatible = "zmk,input-listener";
        device = <&trackball>;
    };
};
